## src/drivers/loadcells/Kconfig
```kconfig
menu "Loadcells"
    menuconfig COMMON_LOADCELLS
        bool "Common load cells"
        default n
        select DRIVERS_LOADCELLS_HX711
        ---help---
            Enable default set of loadcell drivers

    rsource "*/Kconfig"
endmenu
```

## src/drivers/loadcells/hx711/Kconfig
```kconfig
menuconfig DRIVERS_LOADCELLS_HX711
	bool "hx711"
	default n
	---help---
		Enable support for hx711 loadcell amplifier
```

## src/modules/dropboxv2/Kconfig
```kconfig
menuconfig MODULES_DROPBOXV2
	bool "dropboxv2"
	default n
	---help---
		Enable support for dropboxv2

menuconfig USER_DROPBOXV2
	bool "dropboxv2 running as userspace module"
	default n
	depends on BOARD_PROTECTED && MODULES_DROPBOXV2
	---help---
		Put dropboxv2 in userspace memory
```

## src/modules/test_counter/Kconfig
```kconfig
menuconfig MODULES_TEST_COUNTER
	bool "test_counter"
	default n
	---help---
		Enable support for test_counter

menuconfig USER_TEST_COUNTER
	bool "test_counter running as userspace module"
	default y
	depends on BOARD_PROTECTED && MODULES_TEST_COUNTER
	---help---
		Put test_counter in userspace memory
```
